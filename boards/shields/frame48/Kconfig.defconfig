## boards/shields/frame48/Kconfig.defconfig
```kconfig
if SHIELD_FRAME48_LEFT

    config ZMK_KEYBOARD_NAME
        default "Frame48 (Left)"

    config ZMK_SPLIT_BLE_ROLE_CENTRAL
        default y

endif

if SHIELD_FRAME48_RIGHT

    config ZMK_KEYBOARD_NAME
        default "Frame48 (Right)"

endif

if SHIELD_FRAME48_LEFT || SHIELD_FRAME48_RIGHT

    config ZMK_SPLIT
        default y

endif
```

## boards/shields/frame48/Kconfig.shield
```kconfig
config SHIELD_FRAME48_LEFT
    def_bool $(shields_list_contains,frame48_left)

config SHIELD_FRAME48_RIGHT
    def_bool $(shields_list_contains,frame48_right)
```
